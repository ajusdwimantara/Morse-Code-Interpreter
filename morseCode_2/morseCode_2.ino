#include "math.h"
#include <Wire.h>
#include <Adafruit_GFX.h>
#include <Adafruit_SSD1306.h>
#include <pgmspace.h>

#define INPUT_NETWORK 11
#define HIDDEN_NETWORK 25 //15
#define OUTPUT_NETWORK 35

#define buzzer_pin 18
#define button_pin 19

String output_data="";
bool add_space = false;
int buttonState;            // the current reading from the input pin
int lastButtonState = HIGH;  // the previous reading from the input pin

// the following variables are unsigned longs because the time, measured in
// milliseconds, will quickly become a bigger number than can be stored in an int.
unsigned long lastDebounceTime = 0;  // the last time the output pin was toggled
unsigned long debounceDelay = 50;    // the debounce time; increase if the output flickers

bool reseted = false;
float input_data[11] = {0.0,0.0,0.0,0.0,0.0,0.0,0.0,0.0,0.0,0.0,0.0};
// measure
int data_idx;
bool measuring = false;
bool start_measure = false;
bool released_measure = false;
unsigned long dot_time = 0;
unsigned long space_time = 0;
unsigned long pressed_time = 0;
unsigned long released_time = 0;
unsigned long waiting_time = 0;

bool data_ready = false;

// OLED
Adafruit_SSD1306 display(
  128,  // 螢幕寬度
  64,   // 螢幕高度
  &Wire // 指向 Wire 物件的指位器, I2C 通訊用
);

void reset(){
  measuring = false;
  start_measure = false;
  released_measure = false;
  dot_time = millis();
  space_time = millis();
  pressed_time = millis();
  released_time = millis();
  waiting_time = millis();
  data_idx = 0;
  add_space = false;
}

const float weight_hid[] PROGMEM = {0.100005, 0.6, 0.399998, 0.899997, 0.399998, 0.899997, 0.799998, 0.3, 0.300001, 0.799999, 0.199999, 0.100001, 0.4, 2.78285e-06, 0.100002, 0.3, 0.699999, 0.400002, 0.799998, 0.100003, 0.200001, 0.1, 0.799998, 0.799998 ,0.499999,
                                      0.700005, 0.5, -1.87505e-06, 0.599997, 0.599998, 0.899997, 0.899997, 0.8, 0.500002, 0.699998, 0.199999, 0.800002, 0.3, 0.100004, 0.600002, 0.4, 0.499999, 2.12894e-06, 0.699997, 0.400004, 0.200001, 0.300001, 0.799998, -2.70452e-06, 0.699999,
                                      0.300013, 0.899998, 0.699995, 0.899993, 0.499995, -7.70452e-06, 0.79999, 0.8, 0.900005, -4.32816e-06, 0.0999985, 0.800004, 4.62993e-07, 0.90001, 0.500005, 0.3, 0.599997, 0.600005, 0.799992, 0.600008, 0.800003, 0.600002, 0.199993, 0.0999925, 0.0999986,
                                      0.599997, 0.900001, 0.800003, 0.100002, 1.46738e-06, 2.89371e-06, 0.200005, 0.7, 0.699999, 0.700002, 0.700001, -1.0995e-06, 0.6, 0.799997, 0.4, 5.49772e-07, 0.200001, 0.399999, 0.100004, 0.199998, 0.9, 0.7, 0.100004, 3.69409e-06, 0.300001,
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                                      0.2, 0.0, 0.4, 0.2, 0.7, 0.3, 0.1, 0.7, 0.9, 0.2, 0.5, 0.5, 0.0, 0.7, 0.3, 0.6, 0.2, 0.9, 0.5, 0.7, 0.8, 0.6, 0.6, 0.6, 0.8
                                      };

const float threshold_hid[] PROGMEM = {0.699977, 0.800002, 0.900009, 0.200016, 9.60246e-06, 0.600016, 0.700016, 0.3, 0.899991, 0.600008, 3.19478e-06, 0.899991, -7.64025e-07, 0.899985, 0.399991, 0.400001, 0.800005, 0.49999, 0.600014, 0.599984, 0.399995, 0.0999969, 0.800012, 0.900013, 0.100003};

const float weight_out[] PROGMEM = {-10.089, -9.95188, 2.58716, -0.911303, -4.42071, 15.8318, -5.3068, 1.04969, -3.21099, 14.1466, 5.2134, -3.55925, -14.8835, -11.5977, 3.66518, 6.80703, -1.44101, 1.26739, 6.27824, -13.6129, 19.2159, 4.22117, 10.3284, -1.33969, 11.3603, -6.89667, 0.124693, -0.342696,
                                      0.314391, 0.275546, 0.539729, 0.50685, 0.463106, 0.203942, 0.36355, 1.39282, -4.02281, 0.0215149, 6.03705, -10.118, -12.0161, 20.0205, -9.69767, -8.0467, 0.358987, -2.9617, 2.04012, 9.28797, -2.56288, 12.8077, 0.353493, 5.55314, 13.2541, 2.16422, -5.78231, 4.97871,
                                      -8.91172, 5.25829, -1.04648, -10.2552, 6.98716, 0.406173, -0.359272, 0.601436, 0.160585, -0.0769814, 0.188597, 0.249265, 0.488768, 0.24707, 0.730436, 6.19914, 4.47033, -0.44805, -1.44866, -5.45454, 13.6158, 7.54968, -5.70526, 0.200229, -9.71664, 9.2992, 2.81463, -4.06774,
                                      -0.269713, 8.39627, 5.62, 7.65335, -2.47847, 0.425377, -6.78889, -6.40761, -1.0934, -5.24541, -13.2262, 8.79735, 0.376932, -0.195147, -0.245044, 0.0215407, 0.590524, -0.0371058, -0.187564, 0.64446, 0.210149, 7.04508, -4.44367, 3.37657, 6.31082, -7.86735, -6.25947, 8.54127,
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                                      -8.72043, 0.894467, 4.60212, 5.7617, 2.59, 8.04538, -2.70261, 5.54109, -0.254536, -2.99275, 11.7573, -7.69996,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 0.210892, 0.258092};

const float threshold_out[] PROGMEM = {-21.3519, 0.415959, 22.2793, -5.74205, -38.4019, 5.55286, 5.78102, -5.19494, -31.8657, 25.7025, 0.572649, 5.77685, -2.43519,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 1.42481, 1.11073};
class ArtificialNeuralNetwork{
private:
  // --- Input layer to Hidden layer ----
  float Wij;
  
  float threshold_hidden;
  float s_hidden[HIDDEN_NETWORK], y_hidden[HIDDEN_NETWORK];
  float input[INPUT_NETWORK];
  
//   --- Hidden layer to Output layer
  float Wjk;

  float threshold_output;
  float s_output[OUTPUT_NETWORK], y_output[OUTPUT_NETWORK];

public:
  
  ArtificialNeuralNetwork(){
      
  };
  ~ArtificialNeuralNetwork(){};

  void feedForward1(){
    // Reset
    for(int j=0; j<HIDDEN_NETWORK; j++) {
        this->s_hidden[j] = 0;
    }
    // Calculate Strength Hidden
    for(int j=0; j<HIDDEN_NETWORK; j++) {
        for(int i=0; i<INPUT_NETWORK; i++) {
            memcpy_P(&Wij, &weight_hid[i*25 + j], sizeof(float)); // Copy float from PROGMEM to RAM
            this->s_hidden[j] += this->input[i]*Wij;
        }
//        Serial.print("Wij: ");
//        Serial.println(Wij);
    }
    for(int j=0; j<HIDDEN_NETWORK; j++) {
        memcpy_P(&threshold_hidden, &threshold_hid[j], sizeof(float)); // Copy float from PROGMEM to RAM
        this->s_hidden[j] -= this->threshold_hidden;
    }

    // Calculate Activation Function Hidden
    for(int j=0; j<HIDDEN_NETWORK; j++) {
        // Sigmoid
        y_hidden[j] = 1/(1 + exp(-s_hidden[j]));
//        Serial.print("y_hidden: ");
//        Serial.println(y_hidden[j]);
    }
  }
  void feedForward2(){
    // Reset
    for(int k=0; k<OUTPUT_NETWORK; k++) {
        s_output[k] = 0;
    }
    // Calculate Output Strength
     for(int k=0; k<OUTPUT_NETWORK; k++) {
        for(int j=0; j<HIDDEN_NETWORK; j++) {
            memcpy_P(&Wjk, &weight_out[j*35 + k], sizeof(float)); // Copy float from PROGMEM to RAM
            s_output[k] += y_hidden[j]*Wjk;
        }
//        Serial.print("Wjk: ");
//        Serial.println(Wjk, 5);
    }
    for(int k=0; k<OUTPUT_NETWORK; k++) {
        memcpy_P(&threshold_output, &threshold_out[k], sizeof(float)); // Copy float from PROGMEM to RAM
        s_output[k] -= threshold_output;
    }
    

    // Calculate Activation Function
    for(int k=0; k<OUTPUT_NETWORK; k++) {
        // Softmax
        double sumExp = 0.0;

        // Compute the sum of exponentials of input values
        for (float val : s_output) {
            sumExp += exp(val);
        }
        y_output[k] = (exp(s_output[k]) / sumExp);
    }
  }

  void insertInput(float input[]){
    Serial.print("Input: ");
    for(int i=0;i<INPUT_NETWORK;i++){
        this->input[i] = input[i];
//        Serial.print(this->input[i], 5);
    }
//    Serial.println("");
  }

  char displayOutput(){
    int max_index = 0;
    for(int k=0;k<35;k++){
        if(y_output[max_index] < y_output[k]){
            max_index = k;
        }
    }

    int predicted_output[35] = {0};
    predicted_output[max_index] = 1;
    Serial.print("predicted output: ");

    Serial.println((char)(65+max_index));

    return (char)(65+max_index);
  }

  void Test(){
    Serial.println("KONTTT");
  }
};

ArtificialNeuralNetwork* nn1;

void setup() {
  // put your setup code here, to run once:
  nn1 = new ArtificialNeuralNetwork();
  Serial.begin(115200);
  pinMode(buzzer_pin, OUTPUT);
  pinMode(button_pin, INPUT_PULLUP);

  // OLED 初始化
  if(!display.begin(SSD1306_SWITCHCAPVCC, 0x3C)){
    Serial.println("OLED Initialization failed, please reset");
    while(1);
  }
  else{
    Serial.println("OLED Initialization success");
  }
  display.clearDisplay();

  display.setTextSize(1);
  display.setTextColor(WHITE);
  display.setCursor(30, 10);
  // Display static text
  display.println("MORSE CODE");

  display.setCursor(30, 20);
  // Display static text
  display.println("INTERPRETER");
  display.display(); 
}

void loop() {
  // put your main code here, to run repeatedly:
  int reading = digitalRead(button_pin);

  // If the switch changed, due to noise or pressing:
  if (reading != lastButtonState) {
    // reset the debouncing timer
    lastDebounceTime = millis();
  }

  

  if ((millis() - lastDebounceTime) > debounceDelay) {
    // whatever the reading is at, it's been there for longer than the debounce
    // delay, so take it as the actual current state:

    // if the button state has changed:
    if (reading != buttonState) {
      buttonState = reading;

      // only toggle the LED if the new button state is HIGH
      if (buttonState == LOW) {
        digitalWrite(buzzer_pin, HIGH);
        if(!start_measure){
          measuring = true;
          start_measure = true;
          dot_time = millis();
        }
        if(released_measure){
          released_measure = false;
          released_time = millis() - space_time;
          Serial.print("Space: ");
          Serial.println(released_time);
          input_data[data_idx++] = float(released_time)/1000;
        }
      }
      else{
        digitalWrite(buzzer_pin, LOW);
        if(start_measure){
          start_measure = false;
          pressed_time = millis() - dot_time;
          Serial.print("Dot: ");
          Serial.println(pressed_time);
          input_data[data_idx++] = float(pressed_time)/1000;
        }
        if(measuring){
          reseted = false;
          if(!released_measure){
            space_time = millis();
            released_measure = true; 
          }
        }
        
      }
    }
  }

  if(released_measure){
    if(millis() - space_time > 2000.0){
      if(!reseted){
        reset();
        reseted = true;
        Serial.println("KONZZ");
        data_ready = true;
      }
    }
    
  }
  
  
  // save the reading. Next time through the loop, it'll be the lastButtonState:
  lastButtonState = reading;
//  float input[] = {172.0/1000, 183.0/1000, 177.0/1000, 0.0, 0.0, 0.0, 0.0, 0.0, 0.0, 0.0, 0.0};
//  nn1->insertInput(input);
//  nn1->feedForward1();
//  nn1->feedForward2();
//  nn1->displayOutput();

    if(data_ready){
      nn1->insertInput(input_data);
      nn1->feedForward1();
      nn1->feedForward2();
      output_data += nn1->displayOutput();
      data_ready = false;

      Serial.print("word: ");
      Serial.println(output_data);
      for(int i=0;i<INPUT_NETWORK;i++){
        input_data[i] = 0.0;
      }
      waiting_time = millis();
      add_space = true;

      display.clearDisplay();

      display.setTextSize(1);
      display.setTextColor(WHITE);
      display.setCursor(0, 10);
      // Display static text
      display.println(output_data);

      display.display();
    }
    else if((millis() - waiting_time > 1500.0) && (add_space) && (!measuring)){
      add_space = false;
      output_data += " ";
      Serial.print("word: ");
      Serial.println(output_data);

      display.clearDisplay();

      display.setTextSize(1);
      display.setTextColor(WHITE);
      display.setCursor(0, 10);
      // Display static text
      display.println(output_data);

      display.display();
    }
}
